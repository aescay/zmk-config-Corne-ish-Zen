## config/west.yml
```yaml
manifest:
  remotes:
    - name: zmkfirmware
      url-base: https://github.com/aescay
  projects:
    - name: zmk
      remote: zmkfirmware
      revision: update/zmk-zen-configs
      import: app/west.yml
  self:
    path: config
```
